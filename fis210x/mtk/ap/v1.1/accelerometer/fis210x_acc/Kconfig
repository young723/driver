## fis210x/mtk/ap/v1.1/accelerometer/fis210x_acc/Kconfig
```kconfig
config MTK_FIS210X_ACC
	bool "MTK_FIS210X_ACC for MediaTek package"
	default n
	help
	  The FIS210X is a highly integrated,
	  low power internal measurement unit
	  that provides precise acceleration
	  and angular rate (gyroscopic) measurement.
	  It support different accelerometer sensor.
	  If this option is set, it will support
	  MTK_FIX210x Accelerometer.
```

## fis210x/mtk/ap/v1.1/gyroscope/fis210x_gyro/Kconfig
```kconfig
config MTK_FIS210X_GYRO
	bool "FIS210X gyroscope for MediaTek package"
	default n
	help
	  It support different gyroscope sensor.
	  If this option is set,
	  it will support FIS210X gyroscope.
```

## qmaX981/mtk/v3.3/accelerometer/qmaX981/Kconfig
```kconfig
config MTK_QMAX981
	bool "QMAX981 for MediaTek package"
	default n
	help
	  It support different accelerometer sensor.
          If this option is set,
	  it will support
          QMAX981 Accelerometer.
```

## qmc6308/mtk/ap/v1.1/driver/qmc6308/Kconfig
```kconfig
config MTK_QMC6308
	tristate "QMC6308 for MediaTek package"
	default n
	help
	  It support different magnetometer sensor.
	  If this option is set, it will support
	  QMC6308 magnetometer which is a 3-axis electronic
	  compass IC with high sensitive Hall sensor technology.
```

## qmp6988/mtk/v1.1/barometer/barometer/QMP6988-new/Kconfig
```kconfig
config MTK_QMP6988_NEW
	bool "QMP6988 for MediaTek package"
	default n
	help
	It support different type sensor
	in this platform. If this option
	is set, it will support pressure
	QMP6988.
```
